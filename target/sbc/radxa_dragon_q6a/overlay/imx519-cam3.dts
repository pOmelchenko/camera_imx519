// SPDX-License-Identifier: BSD-3-Clause
// J7 pin 11: CAM3_RESET_3V3 drives camera CAM_IO0.
/dts-v1/;
/plugin/;

#define PORT cam3
#define PORT_TITLE "Enable Arducam IMX519 + AK7375 on CAM3"
#define CCI_CONTROLLER cci1
#define CCI_BUS cci1_i2c1
#define PHY 3
#define ENABLE_GPIO 78
#include "imx519-common.dtsi"
