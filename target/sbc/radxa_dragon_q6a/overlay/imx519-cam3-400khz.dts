// SPDX-License-Identifier: BSD-3-Clause
// CAM3/J7 timing from the 2026-10-11 physical capture.
#define IMX519_STARTUP_DELAY_US 100000
#include "imx519-cam3.dts"

&cci1_i2c1 {
	clock-frequency = <400000>;
};
